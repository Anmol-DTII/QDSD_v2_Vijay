/**
 * @file self_test.c
 * @brief Power-on known-answer tests for the MCU crypto the core relies on.
 *
 * Vectors generated offline with pyca/cryptography (fixed test key, not used
 * anywhere else). A failure keeps the token in FAULT with the USB gate closed.
 */
#include <string.h>

#include "port/port.h"
#include "security/self_test.h"

static const uint8_t k_abc_sha256[32] = {
	0xBA, 0x78, 0x16, 0xBF, 0x8F, 0x01, 0xCF, 0xEA, 0x41, 0x41, 0x40, 0xDE, 0x5D, 0xAE,
	0x22, 0x23, 0xB0, 0x03, 0x61, 0xA3, 0x96, 0x17, 0x7A, 0x9C, 0xB4, 0x10, 0xFF, 0x61,
	0xF2, 0x00, 0x15, 0xAD,
};

static const uint8_t k_kat_pub[65] = {
	0x04, 0x1B, 0x3C, 0x00, 0x6F, 0xAA, 0x12, 0x2A,
	0xBF, 0xE4, 0x8B, 0x57, 0xF0, 0xC0, 0x9B, 0x30,
	0x24, 0x1C, 0x44, 0x15, 0x2B, 0x03, 0xC0, 0x31,
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	0x37,
};

/* SHA-256("QDSD power-on self-test") */
static const uint8_t k_kat_hash[32] = {
	0x1B, 0x6E, 0x10, 0x18, 0x21, 0xD0, 0xF3, 0x92,
	0x04, 0x5C, 0x42, 0x47, 0x5A, 0xE7, 0xFB, 0xA8,
	0x8B, 0x1D, 0xB6, 0xFC, 0x48, 0x30, 0xD1, 0xB9,
	0x65, 0xBC, 0xCD, 0x37, 0x92, 0x88, 0x62, 0x70,
};

static const uint8_t k_kat_sig[64] = {
	0x4A, 0x12, 0x60, 0xF5, 0x9A, 0x5D, 0x16, 0x18,
	0xBD, 0x1A, 0x53, 0xC9, 0x6B, 0x2B, 0x7B, 0x05,
	0x32, 0x39, 0x57, 0xA6, 0xC9, 0x76, 0x6E, 0x48,
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	0x1B, 0x59, 0x88, 0x76, 0x3C, 0xB1, 0xFF, 0x32,
};

int qdsd_crypto_selftest(void)
{
	uint8_t h[32];
	uint8_t bad[64];
	uint8_t rnd1[16];
	uint8_t rnd2[16];

	if ((port_sha256((const uint8_t *)"abc", 3U, h) != 0) ||
	    (memcmp(h, k_abc_sha256, sizeof(h)) != 0)) {
		return -1;
	}
	if (port_p256_pubkey_check(k_kat_pub) != 0) {
		return -2;
	}
	if (port_ecdsa_p256_verify(k_kat_pub, k_kat_hash, k_kat_sig) != 0) {
		return -3;
	}
	/* A verifier that accepts everything must fail the self-test. */
	memcpy(bad, k_kat_sig, sizeof(bad));
	bad[63] ^= 0x01U;
	if (port_ecdsa_p256_verify(k_kat_pub, k_kat_hash, bad) == 0) {
		return -4;
	}
	/* RNG must produce output and not repeat itself. */
	if ((port_random(rnd1, sizeof(rnd1)) != 0) || (port_random(rnd2, sizeof(rnd2)) != 0) ||
	    (memcmp(rnd1, rnd2, sizeof(rnd1)) == 0)) {
		return -5;
	}
	return 0;
}
